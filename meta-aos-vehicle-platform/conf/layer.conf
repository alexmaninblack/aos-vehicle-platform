## meta-aos-vehicle-platform/conf/layer.conf
```bitbake
# SPDX-FileCopyrightText: 2026 maninblack
# SPDX-License-Identifier: Apache-2.0

BBPATH .= ":${LAYERDIR}"
BBFILES += "${LAYERDIR}/recipes-*/*/*.bb ${LAYERDIR}/recipes-*/*/*.bbappend"

BBFILE_COLLECTIONS += "aos-vehicle-platform"
BBFILE_PATTERN_aos-vehicle-platform := "^${LAYERDIR}/"
BBFILE_PRIORITY_aos-vehicle-platform = "20"

LAYERSERIES_COMPAT_aos-vehicle-platform = "scarthgap"
```
